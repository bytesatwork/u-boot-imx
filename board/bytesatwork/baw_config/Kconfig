## board/bytesatwork/baw_config/Kconfig
```kconfig
# SPDX-License-Identifier: (GPL-2.0+ OR BSD-3-Clause)
# Copyright (C) 2024 bytesatwork AG - https://www.bytesatwork.io

menu "bytesatwork production data tool"

config CMD_BAW_CONFIG
	bool "bawconfig command"
	default y
	help
	  Enable bawconfig command functionality for
	  running commands from the u-boot console.

config BAW_CONFIG_EEPROM
	bool "bawconfig EEPROM support"
	default y
	help
	  Enable bawconfig EEPROM read/write functionality.
	  Read, write and erase production data on the SoM EEPROM.

config BAW_CONFIG_EEPROM_BUS
	int "bawconfig I2C bus number"
	default 0
	help
	  I2C bus number of configuration EEPROM
	  used on the SoM.

config BAW_CONFIG_EEPROM_ADDRESS
	hex "bawconfig I2C address"
	default 0x50
	help
	  I2C address of configuration EEPROM
	  placed on the SoM.

config BAW_CONFIG_BUILTIN
	bool "bawconfig builtin support"
	default y
	help
	  Enable bawconfig builtin configuration functionality. Additinonally,
	  this allows to write the built-in configuration to the EEPROM if
	  BAW_CONFIG_EEPROM is enabled.

endmenu
```

## board/bytesatwork/bytedevkit/Kconfig
```kconfig
if TARGET_IMX8MM_BYTEDEVKIT

config SYS_BOARD
	default "bytedevkit"

config SYS_VENDOR
	default "bytesatwork"

config SYS_CONFIG_NAME
	default "bytedevkit"

config IMX8MM_BYTEDEVKIT_FSPI_BOOT
	bool "Enable FSPI boot"
	default n

config IMX_CONFIG
	default "board/bytesatwork/bytedevkit/imximage-8mm-lpddr4-fspi.cfg" if IMX8MM_BYTEDEVKIT_FSPI_BOOT
	default "arch/arm/mach-imx/imx8m/imximage.cfg"

endif
```

## board/bytesatwork/bytedevkit_imx8mm/Kconfig
```kconfig
if TARGET_IMX8MM_BYTEDEVKIT

config SYS_BOARD
	default "bytedevkit_imx8mm"

config SYS_VENDOR
	default "bytesatwork"

config SYS_CONFIG_NAME
	default "imx8mm_bytedevkit"

config IMX8MM_BYTEDEVKIT_FSPI_BOOT
	bool "Enable FSPI boot"
	default n

config IMX_CONFIG
	default "board/bytesatwork/bytedevkit_imx8mm/imximage-8mm-lpddr4-fspi.cfg" if IMX8MM_BYTEDEVKIT_FSPI_BOOT
	default "arch/arm/mach-imx/imx8m/imximage.cfg"

source "board/bytesatwork/baw_config/Kconfig"

endif
```

## board/bytesatwork/bytedevkit_imx8mp/Kconfig
```kconfig
if TARGET_IMX8MP_BYTEDEVKIT

config SYS_BOARD
	default "bytedevkit_imx8mp"

config SYS_VENDOR
	default "bytesatwork"

config SYS_CONFIG_NAME
	default "imx8mp_bytedevkit"

config IMX_CONFIG
	default "board/bytesatwork/bytedevkit_imx8mp/imximage-8mp-lpddr4.cfg"

endif
```

## board/bytesatwork/bytedevkit_imx93/Kconfig
```kconfig
# Copyright (C) 2026 bytesatwork AG - https://www.bytesatwork.io

if TARGET_IMX93_BYTEDEVKIT

config SYS_BOARD
	default "bytedevkit_imx93"

config SYS_VENDOR
	default "bytesatwork"

config SYS_CONFIG_NAME
	default "imx93_bytedevkit"

choice
	prompt "Select DDR Type"
	default IMX93_BYTEDEVKIT_LPDDR4X

config IMX93_BYTEDEVKIT_LPDDR4X
	bool "Using LPDDR4X Timing and PMIC voltage"
	select IMX9_LPDDR4X
	help
	  Select the LPDDR4X timing
	  and 0.6V VDDQ

config IMX93_BYTEDEVKIT_LPDDR4X_2GB
	bool "Using LPDDR4X 2GB Timing"
	select IMX9_LPDDR4X
	help
	  Select the LPDDR4X timing
	  for 2GB RAM

config IMX93_BYTEDEVKIT_LPDDR4
	bool "Using LPDDR4 Timing and PMIC voltage"
	select IMX9_LPDDR4X
	help
	  Select the LPDDR4 timing
	  and 1.1V VDDQ

endchoice

source "board/bytesatwork/baw_config/Kconfig"

endif
```

## configs/imx8mm_bytedevkit_defconfig
```kconfig
CONFIG_ARM=y
CONFIG_ARCH_IMX8M=y
CONFIG_TEXT_BASE=0x40200000
CONFIG_SYS_MALLOC_LEN=0x1600000
CONFIG_SPL_GPIO=y
CONFIG_SPL_LIBCOMMON_SUPPORT=y
CONFIG_SPL_LIBGENERIC_SUPPORT=y
CONFIG_NR_DRAM_BANKS=1
CONFIG_SF_DEFAULT_SPEED=50000000
CONFIG_SF_DEFAULT_MODE=0
CONFIG_ENV_SIZE=0x1000
CONFIG_ENV_OFFSET=0x400000
CONFIG_ENV_SECT_SIZE=0x1000
CONFIG_SYS_I2C_MXC_I2C1=y
CONFIG_SYS_I2C_MXC_I2C2=y
CONFIG_SYS_I2C_MXC_I2C3=y
CONFIG_DM_GPIO=y
CONFIG_DEFAULT_DEVICE_TREE="imx8mm-bytedevkit"
CONFIG_SPL_TEXT_BASE=0x7E1000
CONFIG_USB_TCPC=y
CONFIG_TARGET_IMX8MM_BYTEDEVKIT=y
CONFIG_BAW_CONFIG_EEPROM_BUS=1
CONFIG_BAW_CONFIG_EEPROM_BUS_NAME="i2c@30a30000"
CONFIG_SYS_MONITOR_LEN=524288
CONFIG_SPL_MMC=y
CONFIG_SPL_SERIAL=y
CONFIG_SPL_STACK=0x91fff0
CONFIG_SPL=y
CONFIG_IMX_BOOTAUX=y
CONFIG_SYS_LOAD_ADDR=0x40400000
CONFIG_SYS_MEMTEST_START=0x40000000
CONFIG_SYS_MEMTEST_END=0x50000000
CONFIG_REMAKE_ELF=y
CONFIG_FIT=y
CONFIG_FIT_EXTERNAL_OFFSET=0x3000
CONFIG_SPL_LOAD_FIT=y
CONFIG_SYS_BOOTM_LEN=0x02000000
CONFIG_OF_SYSTEM_SETUP=y
CONFIG_USE_BOOTCOMMAND=y
CONFIG_BOOTCOMMAND="run bsp_bootcmd"
CONFIG_DEFAULT_FDT_FILE="imx8mm-bytedevkit.dtb"
CONFIG_SYS_CBSIZE=2048
CONFIG_SYS_PBSIZE=2068
CONFIG_ARCH_MISC_INIT=y
CONFIG_BOARD_EARLY_INIT_F=y
CONFIG_BOARD_LATE_INIT=y
CONFIG_SPL_MAX_SIZE=0x25000
CONFIG_SPL_HAS_BSS_LINKER_SECTION=y
CONFIG_SPL_BSS_START_ADDR=0x910000
CONFIG_SPL_BSS_MAX_SIZE=0x2000
CONFIG_SPL_BOARD_INIT=y
# CONFIG_SPL_SHARES_INIT_SP_ADDR is not set
CONFIG_SYS_MMCSD_RAW_MODE_U_BOOT_USE_SECTOR=y
CONFIG_SYS_MMCSD_RAW_MODE_U_BOOT_SECTOR=0x300
CONFIG_SPL_I2C=y
CONFIG_SPL_NOR_SUPPORT=y
CONFIG_SPL_WATCHDOG=y
CONFIG_HUSH_PARSER=y
CONFIG_CMD_CPUINFO=y
# CONFIG_BOOTM_NETBSD is not set
# CONFIG_CMD_EXPORTENV is not set
# CONFIG_CMD_IMPORTENV is not set
# CONFIG_CMD_CRC32 is not set
CONFIG_CMD_MEMINFO=y
CONFIG_CMD_MEMTEST=y
CONFIG_CMD_FUSE=y
CONFIG_CMD_GPIO=y
CONFIG_CMD_I2C=y
CONFIG_CMD_MMC=y
CONFIG_CMD_USB=y
CONFIG_CMD_USB_MASS_STORAGE=y
CONFIG_CMD_MII=y
CONFIG_CMD_PING=y
CONFIG_CMD_CACHE=y
CONFIG_CMD_REGULATOR=y
CONFIG_CMD_EXT2=y
CONFIG_CMD_EXT4=y
CONFIG_CMD_EXT4_WRITE=y
CONFIG_CMD_FAT=y
CONFIG_CMD_FS_GENERIC=y
CONFIG_OF_CONTROL=y
CONFIG_SPL_OF_CONTROL=y
CONFIG_ENV_OVERWRITE=y
CONFIG_ENV_IS_IN_SPI_FLASH=y
CONFIG_SYS_MMC_ENV_DEV=1
CONFIG_CLK_IMX8MM=y
CONFIG_USB_FUNCTION_FASTBOOT=y
CONFIG_FASTBOOT_BUF_ADDR=0x42800000
CONFIG_FASTBOOT_BUF_SIZE=0x40000000
CONFIG_FASTBOOT_FLASH=y
CONFIG_MXC_GPIO=y
CONFIG_DM_I2C=y
CONFIG_SPL_SYS_I2C_LEGACY=y
CONFIG_SUPPORT_EMMC_BOOT=y
CONFIG_MMC_IO_VOLTAGE=y
CONFIG_MMC_UHS_SUPPORT=y
CONFIG_MMC_HS400_ES_SUPPORT=y
CONFIG_MMC_HS400_SUPPORT=y
CONFIG_FSL_USDHC=y
CONFIG_MTD=y
CONFIG_DM_SPI_FLASH=y
CONFIG_SPI_FLASH_BAR=y
CONFIG_SPI_FLASH_ATMEL=y
CONFIG_SPI_FLASH_ISSI=y
CONFIG_SPI_FLASH_MACRONIX=y
CONFIG_SPI_FLASH_SPANSION=y
CONFIG_SPI_FLASH_STMICRO=y
CONFIG_SPI_FLASH_SST=y
CONFIG_SPI_FLASH_WINBOND=y
CONFIG_PHYLIB=y
CONFIG_DM_ETH_PHY=y
CONFIG_FEC_MXC=y
CONFIG_RGMII=y
CONFIG_MII=y
CONFIG_PINCTRL=y
CONFIG_PINCTRL_IMX8M=y
CONFIG_SPL_POWER_LEGACY=y
CONFIG_POWER_PCA9450=y
CONFIG_DM_REGULATOR=y
CONFIG_DM_REGULATOR_FIXED=y
CONFIG_DM_REGULATOR_GPIO=y
CONFIG_SPL_POWER_I2C=y
CONFIG_DM_SERIAL=y
CONFIG_MXC_UART=y
CONFIG_SPI=y
CONFIG_DM_SPI=y
CONFIG_NXP_FSPI=y
CONFIG_DM_THERMAL=y
CONFIG_USB=y
CONFIG_SPL_USB_HOST=y
CONFIG_USB_EHCI_HCD=y
CONFIG_USB_STORAGE=y
CONFIG_USB_GADGET=y
CONFIG_SPL_USB_GADGET=y
CONFIG_USB_GADGET_MANUFACTURER="FSL"
CONFIG_USB_GADGET_VENDOR_NUM=0x1fc9
CONFIG_USB_GADGET_PRODUCT_NUM=0x0152
CONFIG_CI_UDC=y
CONFIG_SDP_LOADADDR=0x40400000
CONFIG_SPL_USB_SDP_SUPPORT=y
```
